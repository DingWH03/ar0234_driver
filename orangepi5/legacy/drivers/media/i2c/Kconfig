## orangepi5/legacy/drivers/media/i2c/Kconfig
```kconfig
config VIDEO_AR0230
	tristate "Aptina AR0230 sensor support"
	depends on I2C && VIDEO_V4L2 && VIDEO_V4L2_SUBDEV_API
	depends on MEDIA_CAMERA_SUPPORT
	select V4L2_FWNODE
	help
	  Support for the Aptina AR0230 sensor.

	  To compile this driver as a module, choose M here: the
	  module will be called ar0230.

config VIDEO_AR0234
        tristate "ON Semiconductor AR0234 sensor support"
        depends on I2C && VIDEO_DEV
		depends on MEDIA_CAMERA_SUPPORT
        select V4L2_CCI_I2C
		select MEDIA_CONTROLLER
		select VIDEO_V4L2_SUBDEV_API
		select V4L2_FWNODE
        help
          This is a Video4Linux2 sensor driver for the ON Semiconductor
          AR0234 camera.

          To compile this driver as a module, choose M here: the
          module will be called ar0234.
```
